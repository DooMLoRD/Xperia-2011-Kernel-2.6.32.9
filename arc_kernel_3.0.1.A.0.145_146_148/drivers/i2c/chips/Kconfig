## kernel/drivers/mmc/core/Kconfig
```kconfig
#
# MMC core configuration
#

config MMC_UNSAFE_RESUME
	bool "Allow unsafe resume (DANGEROUS)"
	help
	  If you say Y here, the MMC layer will assume that all cards
	  stayed in their respective slots during the suspend. The
	  normal behaviour is to remove them at suspend and
	  redetecting them at resume. Breaking this assumption will
	  in most cases result in data corruption.

	  This option is usually just for embedded systems which use
	  a MMC/SD card for rootfs. Most people should say N here.

config MMC_EMBEDDED_SDIO
	boolean "MMC embedded SDIO device support (EXPERIMENTAL)"
	depends on EXPERIMENTAL
	help
	  If you say Y here, support will be added for embedded SDIO
	  devices which do not contain the necessary enumeration
	  support in hardware to be properly detected.

config MMC_PARANOID_SD_INIT
	bool "Enable paranoid SD card initialization (EXPERIMENTAL)"
	depends on EXPERIMENTAL
	help
	  If you say Y here, the MMC layer will be extra paranoid
	  about re-trying SD init requests. This can be a useful
	  work-around for buggy controllers and hardware. Enable
	  if you are experiencing issues with SD detection.

config MMC_SD_DETECT_CHATTERING
	bool "Prevent chattering of SD card detection support"
	depends on ARCH_MSM7X30
	default n
	help
	  This increases the duration of retrying the SD card
	  detection in order to reduce the effects by the
	  chattering of SD card detect pin.

config MMC_SD_CHECK_BOOT_SIGNATURE
	bool "Safety for uSD card short circuit"
	default n
	help
	  If you say Y here, uSD driver checks boot signature
	  in MBR when detecting uSD card.If boot signature(0xAA55)
	  is invalid, uSD driver considers it as broken or
	  unformatted card and turns SD_VDD off.This avoids
	  abnormal behavior(e.g over current by short mode) with
	  cracked uSD.
```

## kernel/drivers/staging/zram/Kconfig
```kconfig
config XVMALLOC
	bool
	default n

config ZRAM
	tristate "Compressed RAM block device support"
	depends on BLOCK && SYSFS
	select XVMALLOC
	default n
	help
	  Creates virtual block devices called /dev/zramX (X = 0, 1, ...).
	  Pages written to these disks are compressed and stored in memory
	  itself. These disks allow very fast I/O and compression provides
	  good amounts of memory savings.

	  It has several use cases, for example: /tmp storage, use as swap
	  disks and maybe many more.

	  See zram.txt for more information.
	  Project home: http://compcache.googlecode.com/

config ZRAM_NUM_DEVICES
	int "Default number of zram devices"
	depends on ZRAM
	range 1 32
	default 1
	help
	  Select default number of zram devices. You can override this value
	  using 'num_devices' module parameter.

config ZRAM_DEFAULT_PERCENTAGE
	int "Default number of zram percentage"
	depends on ZRAM
	range 10 80
	default 25
	help
	  Select default zram disk size: percentage of total RAM

config ZRAM_DEBUG
	bool "Compressed RAM block device debug support"
	depends on ZRAM
	default n
	help
	  This option adds additional debugging code to the compressed
	  RAM block device driver.

choice ZRAM_COMPRESS
	prompt "compression method"
	depends on ZRAM
	default ZRAM_LZO
	help
	  Select the compression method used by zram.
	  LZO is the default. Snappy compresses a bit worse (around ~2%) but
	  much (~2x) faster, at least on x86-64.
config ZRAM_LZO
	bool "LZO compression"
	select LZO_COMPRESS
	select LZO_DECOMPRESS
config ZRAM_SNAPPY
	bool "Snappy compression"
	depends on SNAPPY_COMPRESS
	depends on SNAPPY_DECOMPRESS
endchoice

config ZRAM_DEFAULT_DISKSIZE
	int "Default size of zram in bytes"
	depends on ZRAM
	default 100663296
	help
	  Set default zram disk size (default ~ 96MB)
```

## kernel/drivers/thermal/Kconfig
```kconfig
#
# Generic thermal sysfs drivers configuration
#

menuconfig THERMAL
	tristate "Generic Thermal sysfs driver"
	help
	  Generic Thermal Sysfs driver offers a generic mechanism for
	  thermal management. Usually it's made up of one or more thermal
	  zone and cooling device.
	  Each thermal zone contains its own temperature, trip points,
	  cooling devices.
	  All platforms with ACPI thermal support can use this driver.
	  If you want this support, you should say Y or M here.

config THERMAL_HWMON
	bool "Hardware monitoring support"
	depends on THERMAL
	depends on HWMON=y || HWMON=THERMAL
	help
	  The generic thermal sysfs driver's hardware monitoring support
	  requires a 2.10.7/3.0.2 or later lm-sensors userspace.

	  Say Y if your user-space is new enough.

config THERMAL_PM8901
	tristate "Qualcomm PM8901 Temperature Alarm"
	depends on PMIC8901
	depends on THERMAL
	default y
	help
	  This enables a thermal Sysfs driver for the PMIC 8901 device. It
	  shows up in Sysfs as a thermal zone with multiple trip points.
	  Enabling the thermal zone device via the mode file results in
	  shifting over temperature shutdown control of the PMIC from hardware
	  to software.
```
